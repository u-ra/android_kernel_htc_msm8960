## arch/arm/mach-msm/htc/m4/Kconfig
```kconfig
config BOARD_HEADER_FILE
	string "HTC board specific header file name"
	default ""

config MACH_M4_UL
	depends on ARCH_MSM8930
	select MACH_HTC
	select SND_SOC_WCD9304_SWITCH_PORT
	bool "HTC M4_UL"
	help
	  Support for the HTC M4_UL device.
```
